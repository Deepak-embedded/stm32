/*
 * modbus_slave.c
 *
 *  Created on: Jun 24, 2024
 *      Author: Dell
 */




#include "string.h"
#include "main.h"



#define SLAVE_ID  1


extern UART_HandleTypeDef huart1;
extern UART_HandleTypeDef huart3;
/* USER CODE END Includes */

uint16_t startAddr;
uint16_t numRegs;
uint8_t TxData[TOTAL_REG_LEN]={0};



static const uint8_t table_crc_hi[] = {
    0x00, 0xC1, 0x81, 0x40, 0x01, 0xC0, 0x80, 0x41, 0x01, 0xC0,
    0x80, 0x41, 0x00, 0xC1, 0x81, 0x40, 0x01, 0xC0, 0x80, 0x41,
    0x00, 0xC1, 0x81, 0x40, 0x00, 0xC1, 0x81, 0x40, 0x01, 0xC0,
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    0x80, 0x41, 0x00, 0xC1, 0x81, 0x40
};

/* Table of CRC values for low-order byte */
static const uint8_t table_crc_lo[] = {
    0x00, 0xC0, 0xC1, 0x01, 0xC3, 0x03, 0x02, 0xC2, 0xC6, 0x06,
    0x07, 0xC7, 0x05, 0xC5, 0xC4, 0x04, 0xCC, 0x0C, 0x0D, 0xCD,
    0x0F, 0xCF, 0xCE, 0x0E, 0x0A, 0xCA, 0xCB, 0x0B, 0xC9, 0x09,
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    0x43, 0x83, 0x41, 0x81, 0x80, 0x40
};

uint16_t crc16(uint8_t *buffer, uint16_t buffer_length){

    uint8_t crc_hi = 0xFF; /* high CRC byte initialized */
    uint8_t crc_lo = 0xFF; /* low CRC byte initialized */
    unsigned int i; /* will index into CRC lookup */

    /* pass through message buffer */
    while (buffer_length--) {
        i = crc_lo ^ *buffer++; /* calculate the CRC  */
        crc_lo = crc_hi ^ table_crc_hi[i];
        crc_hi = table_crc_lo[i];
    }

    return (crc_hi << 8 | crc_lo);
}


void sendData (uint8_t *data, int size,UART_HandleTypeDef *huartx )
{


	uint16_t crc = crc16(data, size);
	data[size] = crc&0xFF;   // CRC LOW
	data[size+1] =(crc>>8)&0xFF;  // CRC HIGH

	(huartx->Instance==USART2)?HAL_GPIO_WritePin(CTRL2_GPIO_Port, CTRL2_Pin, GPIO_PIN_SET):HAL_GPIO_WritePin(CTRL0_GPIO_Port, CTRL0_Pin, GPIO_PIN_SET);      // DE_RE_EN pin high
//	HAL_GPIO_WritePin(CTRL2_GPIO_Port,CTRL2_Pin, GPIO_PIN_SET);
//	HAL_GPIO_WritePin(CTRL0_GPIO_Port, CTRL0_Pin, GPIO_PIN_SET);
	HAL_Delay(10);
	HAL_UART_Transmit(huartx, data,size+2,HAL_MAX_DELAY);
	HAL_Delay(10);
    (huartx->Instance==USART2)?HAL_GPIO_WritePin(CTRL2_GPIO_Port, CTRL2_Pin, GPIO_PIN_RESET):HAL_GPIO_WritePin(CTRL0_GPIO_Port, CTRL0_Pin, GPIO_PIN_RESET);      // DE_RE_EN pin high
//	HAL_GPIO_WritePin(CTRL0_GPIO_Port, CTRL0_Pin, GPIO_PIN_RESET);
//	HAL_GPIO_WritePin(CTRL2_GPIO_Port,CTRL2_Pin, GPIO_PIN_RESET);



}



//void readHoldingRegs (uint16_t addr)
//{
//	static uint8_t TxData[8];
//	startAddr = addr;//((RxData[2]<<8)|RxData[3]);  // start Register Address
//	TxData[0] = slave_id;  // slave ID
//	TxData[1] = 0x03;//RxData[1];  // function code
//	TxData[2] = (addr>>8)&0xff;
//	TxData[3] = addr&0xff;
//	TxData[4] = 0x00;
//	TxData[5] =0x08;
//	sendData(TxData, 6);  // send data... CRC will be calculated in the function itself
//}
void writeHoldingRegs(TYPE_t datatype,UART_HandleTypeDef *huartx){
	  	 memset(TxData,0,TOTAL_REG_LEN);
	  	 uint8_t indx;
	  	 if(huartx->Instance==USART1){
			 startAddr = ((uart1RxData[2]<<8)|uart1RxData[3]);  // start Register Address
			 numRegs = ((uart1RxData[4]<<8)|uart1RxData[5]);   // number to registers master has requested
			 TxData[SID] = slave_id;  // slave ID
			 		TxData[FC] = uart1RxData[1];  // function code
			 		TxData[TOTAL_BYTE] = numRegs*2;  // Byte count
			 		 indx = DATA_BYTE;  // we need to keep track of how many bytes has been stored in TxData Buffer

			 //Data are store in big endianess manar

			 		if(datatype==UINT32_T){//for 32 bit 2 register will use for write
			 			//reglen=((numRegs&0x01)?numRegs:(numRegs/2));
			 			for (uint8_t i=0; i<((numRegs&0x01)?numRegs:(numRegs/2)); i++)   // Load the actual data into TxData buffer
			 			{
			 					//first register

			 					TxData[indx++] = (Holding_Registers_Database[i]>>24)&0xFF;  // extract the higher byte
			 					TxData[indx++] = (uint8_t)(Holding_Registers_Database[i]>>16)&0xFF;   // extract the lower byte
			 					//second register
			 					if((numRegs&0x01)==0){
			 						TxData[indx++] = (uint8_t)(Holding_Registers_Database[i]>>8)&0xFF;  // extract the higher byte
			 						TxData[indx++] = (uint8_t)(Holding_Registers_Database[i])&0xFF;   // extract the lower byte
			 					}

			 			}
			 		}
			 		else if(datatype==UINT16_T){
			 			for (uint8_t i=0; i<(numRegs); i++)   // Load the actual data into TxData buffer
			 			{
			 				TxData[indx++] = (uint8_t)(Holding_Registers_Database[i]>>8)&0xFF;  // extract the higher byte
			 				TxData[indx++] = (uint8_t)(Holding_Registers_Database[i])&0xFF;   // extract the lower byte
			 			}

			 		}

	  	 }
	  	 else if(huartx->Instance==USART2){
			 startAddr = ((uart2RxData[2]<<8)|uart2RxData[3]);  // start Register Address
			 numRegs = ((uart2RxData[4]<<8)|uart2RxData[5]);   // number to registers master has requested
			 TxData[SID] = slave_id;  // slave ID
			 		TxData[FC] = uart1RxData[1];  // function code
			 		TxData[TOTAL_BYTE] = numRegs*2;  // Byte count
			 		indx = DATA_BYTE;  // we need to keep track of how many bytes has been stored in TxData Buffer

			 //Data are store in big endianess manar

			 		if(datatype==UINT32_T){//for 32 bit 2 register will use for write
			 			//reglen=((numRegs&0x01)?numRegs:(numRegs/2));
			 			for (uint8_t i=0; i<((numRegs&0x01)?numRegs:(numRegs/2)); i++)   // Load the actual data into TxData buffer
			 			{
			 					//first register

			 					TxData[indx++] = (Holding_Registers_Database[i]>>24)&0xFF;  // extract the higher byte
			 					TxData[indx++] = (uint8_t)(Holding_Registers_Database[i]>>16)&0xFF;   // extract the lower byte
			 					//second register
			 					if((numRegs&0x01)==0){
			 						TxData[indx++] = (uint8_t)(Holding_Registers_Database[i]>>8)&0xFF;  // extract the higher byte
			 						TxData[indx++] = (uint8_t)(Holding_Registers_Database[i])&0xFF;   // extract the lower byte
			 					}

			 			}
			 		}
			 		else if(datatype==UINT16_T){
			 			for (uint8_t i=0; i<(numRegs); i++)   // Load the actual data into TxData buffer
			 			{
			 				TxData[indx++] = (uint8_t)(Holding_Registers_Database[i]>>8)&0xFF;  // extract the higher byte
			 				TxData[indx++] = (uint8_t)(Holding_Registers_Database[i])&0xFF;   // extract the lower byte
			 			}

			 		}

	  	 }
		// Prepare TxData buffer


		sendData(TxData,indx,huartx);  // send data... CRC will be calculated in the function itself

}






